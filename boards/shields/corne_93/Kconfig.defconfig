## boards/shields/corne_93/Kconfig.defconfig
```kconfig
if SHIELD_CORNE_93_LEFT

config ZMK_KEYBOARD_NAME
    default "corne_93"

config ZMK_SPLIT_ROLE_CENTRAL
    default y

endif # SHIELD_CORNE_93_LEFT

if SHIELD_CORNE_93_LEFT || SHIELD_CORNE_93_RIGHT

config ZMK_SPLIT
    default y

endif # SHIELD_CORNE_93_LEFT || SHIELD_CORNE_93_RIGHT
```

## boards/shields/corne_93/Kconfig.shield
```kconfig
config SHIELD_CORNE_93_LEFT
    def_bool $(shields_list_contains,corne_93_left)

config SHIELD_CORNE_93_RIGHT
    def_bool $(shields_list_contains,corne_93_right)
```

## boards/shields/testtest/Kconfig.defconfig
```kconfig
if SHIELD_TESTTEST_LEFT

config ZMK_KEYBOARD_NAME
    default "testtest"

config ZMK_SPLIT_ROLE_CENTRAL
    default y

endif # SHIELD_TESTTEST_LEFT

if SHIELD_TESTTEST_LEFT || SHIELD_TESTTEST_RIGHT

config ZMK_SPLIT
    default y

endif # SHIELD_TESTTEST_LEFT || SHIELD_TESTTEST_RIGHT
```

## boards/shields/testtest/Kconfig.shield
```kconfig
config SHIELD_TESTTEST_LEFT
    def_bool $(shields_list_contains,testtest_left)

config SHIELD_TESTTEST_RIGHT
    def_bool $(shields_list_contains,testtest_right)
```
